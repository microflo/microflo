

static const unsigned char max7219_characters[38][8]={
    {0x3C,0x42,0x42,0x42,0x42,0x42,0x42,0x3C},//0
    {0x10,0x18,0x14,0x10,0x10,0x10,0x10,0x10},//1
    {0x7E,0x2,0x2,0x7E,0x40,0x40,0x40,0x7E},//2
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    {0x0,0x7F,0x2,0x4,0x8,0x10,0x20,0x7F},//Z
};

// TODO: split out some of this into parallel->serial SPI like components?
class LedMatrixMax : public SingleOutputComponent {
public:
    LedMatrixMax()
        : pin_cs(-1)
        , pin_din(-1)
        , pin_clk(-1)
        , initialized(false)
    {}

    virtual void process(Packet in, MicroFlo::PortId port) {
        using namespace LedMatrixMaxPorts;
        if (port == InPorts::in) {
            if (in.isInteger() && in.asInteger() < 38) {
                charIndex = in.asInteger();
            } else if (in.isByte()) {
                const unsigned char c = in.asByte();
                if (c > 'A' && c <= 'Z') {
                    charIndex = 10 + c-'A';
                }
            }
            update();
        } else if (port == InPorts::pinclk) {
            pin_clk = in.asInteger();
            initialized = false;
            update();
        } else if (port == InPorts::pincs) {
            pin_cs = in.asInteger();
            initialized = false;
            update();
        } else if (port == InPorts::pindin) {
            pin_din = in.asInteger();
            initialized = false;
            update();
        }
    }
private:
    void update() {
        if (pin_cs < 0 || pin_din < 0 || pin_clk < 0) {
            return;
        }
        if (!initialized) {
            io->PinSetMode(pin_cs, IO::OutputPin);
            io->PinSetMode(pin_din, IO::OutputPin);
            io->PinSetMode(pin_clk, IO::OutputPin);
            max7219_init();
            initialized = true;
        }
        for (uint8_t i=1; i<9; i++) {
            max7219_write(i, max7219_characters[charIndex][i-1]);
        }
    }

    void max7219_write_byte(unsigned char DATA) {
       for (uint8_t i=8; i>=1; i--) {
            io->DigitalWrite(pin_clk, false);
            io->DigitalWrite(pin_din, DATA&0x80);
            io->DigitalWrite(pin_clk, true);
            DATA = DATA<<1;
       }
    }

    void max7219_write(unsigned char address, unsigned char dat) {
       io->DigitalWrite(pin_cs, false);
       max7219_write_byte(address);
       max7219_write_byte(dat);
       io->DigitalWrite(pin_cs, true);
    }

    void max7219_init() {
        max7219_write(0x09, 0x00);       // decoding: BCD
        max7219_write(0x0a, 0x03);       // brightness
        max7219_write(0x0b, 0x07);       // scanlimit: 8 leds
        max7219_write(0x0c, 0x01);       // 0=power-down,1=normal
        max7219_write(0x0f, 0x00);       // 1=test-display, 0=EOT
    }

private:
    int pin_cs;
    int pin_din;
    int pin_clk;
    bool initialized;
    uint8_t charIndex;
};
